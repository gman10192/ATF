// File generated 10/31/2017 10:54:29 PM
// Warning! This is a generated file, any manual changes will be
// lost during the next generation.

#constant  Strings0Count    19
#constant  Strings0Size     14
#constant  Strings2Count    10
#constant  Strings2Size     50
// object indexes into ImageControl
#CONST
    iForm0          // offset 0x0
    iLeddigits0     // offset 0xBBA00
    iiLeddigits0    // offset 0xBDC00
    iLeddigits1     // offset 0xC4C00
    iiLeddigits1    // offset 0xC6E00
    iLeddigits2     // offset 0xCDE00
    iiLeddigits2    // offset 0xD0000
    iLeddigits3     // offset 0xD5400
    iiLeddigits3    // offset 0xD7600
    iLeddigits5     // offset 0xDCA00
    iiLeddigits5    // offset 0xDEC00
    iStatictext0    // offset 0xE4000
    iStatictext1    // offset 0xE4600
    iStatictext2    // offset 0xE5000
    iStatictext3    // offset 0xE7200
    iStatictext4    // offset 0xE8C00
    iStatictext5    // offset 0xE9800
    iLeddigits6     // offset 0xEB200
    iiLeddigits6    // offset 0xED400
    iLeddigits4     // offset 0xF4400
    iiLeddigits4    // offset 0xF6600
    iStatictext6    // offset 0xFD600
    iStatictext7    // offset 0xFE400
    iStatictext8    // offset 0xFF000
    iStatictext9    // offset 0xFF800
    iWinbutton0     // offset 0x100400
    iStatictext10   // offset 0x107C00
    iTrackbar0      // offset 0x10A800
    iWinbutton1     // offset 0x17E200
    iWinbutton2     // offset 0x185A00
    iWinbutton3     // offset 0x18D200
    iWinbutton4     // offset 0x194A00
    iWinbutton5     // offset 0x19C200
    iUserled0       // offset 0x1A3A00
    iStatictext11   // offset 0x1A4400
    iWinbutton6     // offset 0x1A5200
    iAngularmeter0  // offset 0x1ACA00
    iWinbutton7     // offset 0x1FD200
    iWinbutton8     // offset 0x204A00
    iWinbutton9     // offset 0x20C200
    iWinbutton10    // offset 0x213A00
    iStatictext14   // offset 0x21B200
    iStatictext12   // offset 0x21F200
    iWinbutton11    // offset 0x225600
    iWinbutton12    // offset 0x22CE00
    iWinbutton13    // offset 0x234600
    iWinbutton14    // offset 0x23BE00
    iWinbutton15    // offset 0x243600
    iWinbutton16    // offset 0x24AE00
    iStatictext13   // offset 0x252600
    iWinbutton17    // offset 0x257A00
    iWinbutton18    // offset 0x25F200
    iWinbutton21    // offset 0x266A00
    iWinbutton22    // offset 0x26A600
    iWinbutton19    // offset 0x271E00
#END

#constant  Strings1Size     0
#constant  Strings1StartH   0
#constant  Strings1StartL   0
#constant  Strings0StartH   0x0
#constant  Strings0StartL   0x0
#constant  Strings2StartH   0x0
#constant  Strings2StartL   0x200
#IFNOT EXISTS NOGLOBALS
var hndl ;
#ENDIF
